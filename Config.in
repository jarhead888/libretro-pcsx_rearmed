## Config.in
```kconfig
config BR2_PACKAGE_LIBRETRO_PCSX_REARMED
        bool "libretro-pcsx_rearmed"
	depends on BR2_PACKAGE_RETROARCH
	depends on BR2_INSTALL_LIBSTDCPP
        help
          A libretro pcsx reamred emulator core for ARM.

	  http://www.libretro.com

comment "LIBRETRO_FBA needs a toolchain w/ C++"
	depends on !BR2_INSTALL_LIBSTDCPP
```
